## sample.yaml
```
sample:
  description: Native_posix 802.15.4 radio api test
  name: ieee802154_test
common:
  tags: net ieee802154
  harness: net
tests:
  sample.net.wpanusb:
    depends_on: ieee802154
  sample.net.wpanusb_frdm_cr20a:
    extra_args: SHIELD=frdm_cr20a
    platform_whitelist: frdm_k64f
```

## prj.conf
```kconfig
CONFIG_NETWORKING=y
CONFIG_NET_PKT_TX_COUNT=4
CONFIG_NET_BUF_DATA_SIZE=128

CONFIG_IEEE802154=y
CONFIG_IEEE802154_RAW_MODE=y

CONFIG_SHELL=n
CONFIG_KERNEL_SHELL=n

CONFIG_NET_CONFIG_SETTINGS=y
CONFIG_NET_CONFIG_AUTO_INIT=n
CONFIG_NET_LOG=y
CONFIG_BUILD_OUTPUT_HEX=y
CONFIG_BUILD_OUTPUT_EXE=y
```

## src/main.c
```c
/*
 * Copyright (c) 2020 Nordic Semiconductor
 *
 * SPDX-License-Identifier: Apache-2.0
 */

#define LOG_LEVEL 4
#include <logging/log.h>
LOG_MODULE_REGISTER(wpancmd);

#include <stdio.h>
#include <zephyr.h>
#include <net/buf.h>
#include <stdlib.h>
#include <string.h>
#include <time.h>
#include <fcntl.h>
#include <net/ieee802154_radio.h>
#include <ieee802154/ieee802154_frame.h>
#include <net_private.h>
#include "config_parser.h"

#include "posix_board_if.h"

#define TEST_WAIT_FOR_RX_TIMEOUT_MS (1000)
#define TEST_DATA_FILE "../../../test_data"
#define CFG_COLS_OFFSET (0)

typedef struct ieee802154_test_config {
	uint8_t ieee_addr[8];
	uint8_t short_addr[2];
	uint8_t pan_id[2];
	bool is_pan_coord;
} ieee802154_test_config_t;

typedef struct ieee802154_test {
	/* Data to send */
	uint8_t **tx;

	/* Expected response, NULL if response is not expected */
	uint8_t **expected_rx;

	/* Actual received response.
         * Can be read only if rx_wait sem was successfully taken.
         */
	uint8_t *actual_rx;

	/* Executed tests counter */
	int ctr;

	/* Total number of tests */
	int ntests;

	/** Semaphore for transmissions and responses synchronisation.
         *  Given by net_recv_data on any reception.
         */
	struct k_sem rx_wait;

	/* Results of tests*/
	bool *results;

	/** Device config for each test */
	ieee802154_test_config_t *configs;
} ieee802154_test_t;

static struct ieee802154_radio_api *radio_api;
static struct device *ieee802154_dev;
static ieee802154_test_t test_data = { .tx = NULL,
				       .expected_rx = NULL,
				       .results = NULL,
				       .ctr = 0,
				       .ntests = 0 };

static int tx(struct net_pkt *pkt)
{
	struct net_buf *buf = net_buf_frag_last(pkt->buffer);
	int ret;

	ret = radio_api->tx(ieee802154_dev, IEEE802154_TX_MODE_DIRECT, pkt,
			    buf);
	if (ret) {
		printk("Error sending data\n");
	}

	return ret;
}

/** Fill the packet with the data
 * 
 * Arguments:
 * pkt		-	The pointer that pkt will be allocated on
 * psdu		-	The data that pkt will be filled with. psdu[0] must 
 * 				be the data length
 * 
 * Returns:
 * 0		-	Success
 * Negative - 	Failure
 */
static int net_pkt_fill(struct net_pkt **pkt, uint8_t *psdu)
{
	uint8_t packet_len = psdu[0];

	*pkt = net_pkt_alloc_with_buffer(NULL, packet_len, AF_UNSPEC, 0,
					 K_FOREVER);
	if (!(*pkt)) {
		return -ENOMEM;
	}

	net_pkt_cursor_init(*pkt);
	net_pkt_write(*pkt, psdu + 1, packet_len);
	printk("pkt %p len %u\n", *pkt, packet_len);
	return 0;
}

/** Function called by the lower layer of the network stack */
int net_recv_data(struct net_if *iface, struct net_pkt *pkt)
{
	size_t len = net_pkt_get_len(pkt);
	uint8_t rx_buf[127];
	uint8_t *p = rx_buf;
	int ret;
	struct net_buf *buf;

	LOG_INF("Got data, pkt %p, len %d", pkt, len);

	net_pkt_hexdump(pkt, "<");

	if (len > (127 - 2)) {
		LOG_ERR("Too large packet");
		ret = -ENOMEM;
		goto out;
	}

	buf = net_buf_frag_last(pkt->buffer);
	test_data.actual_rx = malloc(buf->len + 1);
	memcpy(test_data.actual_rx + 1, buf->data, buf->len);
	test_data.actual_rx[0] = buf->len;
	k_sem_give(&test_data.rx_wait);

	/**
	 * Add length 1 byte
	 */
	*p++ = (uint8_t)len;

	/* This is needed to work with pkt */
	net_pkt_cursor_init(pkt);

	ret = net_pkt_read(pkt, p, len);
	if (ret < 0) {
		LOG_ERR("Cannot read pkt");
		goto out;
	}

	p += len;

	/**
	 * Add LQI at the end of the packet
	 */
	*p = net_pkt_ieee802154_lqi(pkt);

out:
	net_pkt_unref(pkt);

	return ret;
}

/** Configure addresses of this device */
static void device_addr_set(const uint8_t *addr, bool extended, bool pan)
{
	struct ieee802154_filter filter;

	if (pan) {
		filter.pan_id = *(uint16_t *)addr;
		radio_api->filter(ieee802154_dev, true,
				  IEEE802154_FILTER_TYPE_PAN_ID, &filter);
	} else if (extended) {
		filter.ieee_addr = (uint8_t *)addr;
		radio_api->filter(ieee802154_dev, true,
				  IEEE802154_FILTER_TYPE_IEEE_ADDR, &filter);
	} else {
		filter.short_addr = *(uint16_t *)addr;
		radio_api->filter(ieee802154_dev, true,
				  IEEE802154_FILTER_TYPE_SHORT_ADDR, &filter);
	}
}

/** Set coordinator role of the device */
static void set_coord_role(bool enabled)
{
	const struct ieee802154_config config = { .pan_coordinator = enabled };

	radio_api->configure(ieee802154_dev, IEEE802154_CONFIG_PAN_COORDINATOR,
			     &config);
}

static void radio_configure(ieee802154_test_config_t *config)
{
	set_coord_role(config->is_pan_coord);
	device_addr_set(config->ieee_addr, true, false);
	device_addr_set(config->pan_id, false, true);
	device_addr_set(config->short_addr, false, false);
}

static void radio_init(void)
{
	enum ieee802154_config_type config_type =
		IEEE802154_CONFIG_AUTO_ACK_FPB;
	const struct ieee802154_config config = {
		.auto_ack_fpb.enabled = true,
		.auto_ack_fpb.mode = IEEE802154_FPB_ADDR_MATCH_ZIGBEE
	};

	uint8_t channel = 20;
	int8_t power = -12;

	net_pkt_init();
	ieee802154_dev =
		device_get_binding(CONFIG_IEEE802154_NATIVE_POSIX_DRV_NAME);

	if (ieee802154_dev) {
		radio_api = (struct ieee802154_radio_api *)
				    ieee802154_dev->api;
	} else {
		printk("Couldn't bind %s\n",
		       CONFIG_IEEE802154_NATIVE_POSIX_DRV_NAME);
		posix_exit(-EFAULT);
	}

	printf("%10s\n", "Radio configuration:");
	printf("%-10s %u\n", "Channel:", channel);
	printf("%-10s %d dBm\n", "Power:", power);
	printf("Configuration can be changed either via "
	       "menuconfig or prj.conf\n\n");

	radio_api->set_channel(ieee802154_dev, channel);
	radio_api->set_txpower(ieee802154_dev, power);
	radio_api->configure(ieee802154_dev, config_type, &config);

	int status = radio_api->start(ieee802154_dev);
	if (status) {
		printf("Radio couldn't be started - "
		       "make sure that program was started in babble sim mode (-bsim)");
		posix_exit(-EFAULT);
	}
}

/**
 * Loads tests config from config_file and fills test_data
 * 
 * Returns:
 * entries number   -       1 or more entries in test_data was filled
 * negative         -       Parsing failure
 */
static int load_test_data(const char *config_file, ieee802154_test_t *test_data)
{
	int configs_ctr;
	int tests_num;
	struct config_parser tests_parser = {
		.ncols = 10,
		.datatypes = { CSV_DATATYPE_BYTESTREAM, CSV_DATATYPE_BYTESTREAM,
			       CSV_DATATYPE_BYTESTREAM, CSV_DATATYPE_BOOLEAN,
			       CSV_DATATYPE_BYTESTREAM, CSV_DATATYPE_BYTESTREAM,
			       CSV_DATATYPE_BYTESTREAM, CSV_DATATYPE_BOOLEAN,
			       CSV_DATATYPE_BYTESTREAM,
			       CSV_DATATYPE_BYTESTREAM },
	};

	if (!config_openfile(config_file)) {
		return -EIO;
	}

	tests_num = get_config_lines_number();

	/** TODO: Handle malloc possible failures */
	test_data->tx = malloc(sizeof(uint8_t *) * tests_num);
	test_data->expected_rx = malloc(sizeof(uint8_t *) * tests_num);
	test_data->results = malloc(sizeof(bool) * tests_num);
	test_data->configs =
		malloc(sizeof(ieee802154_test_config_t) * tests_num);
	k_sem_init(&test_data->rx_wait, 0, 1);
	test_data->ctr = 0;

	configs_ctr = 0;
	for (;; configs_ctr++) {
		if (!config_parse_line(&tests_parser)) {
			config_parser_clean(&tests_parser);
			break;
		}

		/** tx data is in 8th column in the config file */
		int tx_size = tests_parser.dest[8].bytestream[0];
		/** expected rx is in the 9th column in the config file */
		int rx_size = tests_parser.dest[9].bytestream[0];

		test_data->tx[configs_ctr] = malloc(tx_size + 1);
		test_data->expected_rx[configs_ctr] =
			rx_size > 0 ? malloc(rx_size) : NULL;

		memcpy(test_data->tx[configs_ctr],
		       tests_parser.dest[8].bytestream, tx_size + 1);

		memcpy(test_data->configs[configs_ctr].ieee_addr,
		       tests_parser.dest[CFG_COLS_OFFSET + 0].bytestream + 1,
		       8);
		memcpy(test_data->configs[configs_ctr].short_addr,
		       tests_parser.dest[CFG_COLS_OFFSET + 1].bytestream + 1,
		       2);
		memcpy(test_data->configs[configs_ctr].pan_id,
		       tests_parser.dest[CFG_COLS_OFFSET + 2].bytestream + 1,
		       2);

		test_data->configs[configs_ctr].is_pan_coord =
			*tests_parser.dest[3].boolean;

		if (test_data->expected_rx[configs_ctr]) {
			memcpy(test_data->expected_rx[configs_ctr],
			       tests_parser.dest[9].bytestream, rx_size + 1);
		}

		config_parser_clean(&tests_parser);
	}

	test_data->ntests = configs_ctr;
	config_closefile();

	return configs_ctr;
}

static void test_data_release(void)
{
	for (int i = 0; i < test_data.ntests; i++) {
		free(test_data.tx[i]);
		free(test_data.expected_rx[i]);
	}

	free(test_data.tx);
	free(test_data.expected_rx);
	free(test_data.results);
}

/**
 * Send bytes using radio_api.
 * 
 * Arguments:
 * bytes	-	data to send, bytes[0] is the size of following data
 * 
 * Returns:
 * 0		-	Tx suceeded
 * Negative     -	Tx failed
 */
static int send_bytes(uint8_t *bytes)
{
	struct net_pkt *netpkt;
	int tx_status;

	net_pkt_fill(&netpkt, bytes);
	tx_status = tx(netpkt);
	net_pkt_unref(netpkt);
	printf("Frame transmission %s\n", !tx_status ? "succeded" : "failed");
	return tx_status;
}

static void execute_tests(void)
{
	for (test_data.ctr = 0; test_data.ctr < test_data.ntests;
	     test_data.ctr++) {
		radio_configure(&test_data.configs[test_data.ctr]);
		k_sem_reset(&test_data.rx_wait);

		int tx_result = send_bytes(test_data.tx[test_data.ctr]);
		int sem_result;

		if (tx_result) {
			test_data.results[test_data.ctr] = false;
			continue;
		}

		sem_result = k_sem_take(&test_data.rx_wait,
					K_MSEC(TEST_WAIT_FOR_RX_TIMEOUT_MS));

		/* Sem taken or timed out, check if rx was required */
		if (test_data.expected_rx[test_data.ctr]) {
			if (0 == sem_result) {
				/* Rx required and received */
				test_data.results[test_data.ctr] = true;
				if (test_data.actual_rx[0] ==
				    test_data.expected_rx[test_data.ctr][0]) {
					if (0 ==
					    memcmp(&test_data.actual_rx[1],
						   &test_data.expected_rx
							    [test_data.ctr][1],
						   test_data.actual_rx[0])) {
						test_data.results[test_data.ctr] =
							true;
					} else {
						test_data.results[test_data.ctr] =
							false;
					}
				}

				free(test_data.actual_rx);
				test_data.actual_rx = NULL;
			} else {
				/* Rx required and not received */
				test_data.results[test_data.ctr] = false;
			}
		} else {
			if (0 == sem_result) {
				/* Rx not required and received */
				test_data.results[test_data.ctr] = false;
				free(test_data.actual_rx);
				test_data.actual_rx = NULL;
			} else {
				/* Rx not required and not received */
				test_data.results[test_data.ctr] = true;
			}
		}
	}

	printf("\n***\tTest Results\t***\n");
	for (int i = 0; i < test_data.ntests; i++) {
		printf("[%d] %10s\n", i,
		       test_data.results[i] ? "Passed" : "Failed");
	}
}

void main(void)
{
	/* Do the device binding, start the radio and initialize net_pkt */
	radio_init();

	/* Load test data from file and init test_data structure */
	load_test_data(TEST_DATA_FILE, &test_data);

	/* Give some time receivers to start receiving */
	k_msleep(100);

	/* Start tests execution */
	execute_tests();

	/* Cleanup */
	test_data_release();

	/* Terminate */
	posix_exit(0);
}
```

## src/config_parser.h
```c
#ifndef _CONFIG_PARSER_H
#define _CONFIG_PARSER_H

#include <stdint.h>
#include <stdbool.h>

#define MAX_COLS_IN_FILE (10)
#define MAX_COLUMN_LEN (260)
#define IGNORE_LINE_CHAR '#'
#define MAX_LINE_LEN (500)
#define SEPARATOR_CHAR ','

enum csv_datatypes {
	CSV_DATATYPE_BYTESTREAM,
	CSV_DATATYPE_STRING,
	CSV_DATATYPE_BOOLEAN
};

/* Describes the line of comma separated columns */
struct config_parser {
	/** Required number of columns in the line */
	int ncols;

	/** Datatype of each column */
	enum csv_datatypes datatypes[MAX_COLS_IN_FILE];

	/** Stores successfully parsed data */
	union {
		void *any;
		uint8_t *bytestream;
		bool *boolean;
		char *str;
	} dest[MAX_COLS_IN_FILE];
};

#ifdef __cplusplus
extern "C" {
#endif

bool config_openfile(const char *filename);
void config_closefile(void);
bool config_parse_line(struct config_parser *parser);
void config_parser_clean(struct config_parser *parser);
int get_config_lines_number(void);

#ifdef __cplusplus
}
#endif

#endif /* _CONFIG_PARSER_H */
```

## src/ieee802154_types.c
```c
#include "ieee802154_types.h"

#include <stdarg.h>
#include <stdio.h>
#include <stdbool.h>
#include <errno.h>


typedef struct {
	to_bytes_t to_bytes;
} addr_any_t;

static int data_frame_to_bytes(void *data_frame, uint8_t *bytes)
{
	data_frame_t *frame = data_frame;
	int offset = 0;

	memcpy(bytes, frame->frame_control, 3);
	offset += 3;
	offset += ((addr_any_t *)frame->address)
			  ->to_bytes(frame->address, bytes + offset);

	/* omitting security - it's not supported now */
	memcpy(bytes + offset, frame->payload, frame->_payload_len);
	offset += frame->_payload_len;
	memcpy(bytes + offset, frame->fcs, 2);
	offset += 2;

	return offset;
}

static void data_frame_dtor(void **data_frame)
{
	data_frame_t *frame = *data_frame;

	if (frame->address) {
		free(frame->address);
	}
	if (frame->security) {
		free(frame->security);
	}
	if (frame->payload) {
		free(frame->security);
	}

	free(*data_frame);
}

static int ext_addr_to_bytes(void *paddr, uint8_t *buf)
{
	address_fields_ext_t *addr = paddr;

	memcpy(buf, addr->dest_pan_ID, 2);
	memcpy(buf + 2, addr->dest_addr, 8);
	memcpy(buf + 10, addr->src_pan_ID, 2);
	memcpy(buf + 12, addr->src_addr, 8);

	return 20; /* buf offset */
}

static int short_addr_to_bytes(void *paddr, uint8_t *buf)
{
	address_fields_short_t *addr = paddr;

	memcpy(buf, addr->dest_pan_ID, 2);
	memcpy(buf + 2, addr->dest_addr, 2);
	memcpy(buf + 4, addr->src_pan_ID, 2);
	memcpy(buf + 6, addr->src_addr, 2);

	return 8; /* buf offset */
}

void *frame_create(unsigned long frame_type, ...)
{
	va_list args;
	void *frame = NULL;

	switch (frame_type) {
	case FRAME_TYPE_DATA:
		va_start(args, frame_type);
		bool use_ext_addr = va_arg(args, unsigned long);
		uint8_t payload_len = va_arg(args, unsigned long);

		data_frame_t *data_frame = malloc(sizeof(data_frame_t));
		if (!data_frame) {
			break;
		}

		if (use_ext_addr) {
			address_fields_ext_t *addr =
				malloc(sizeof(address_fields_ext_t));
			if (!addr) {
				free(data_frame);
				break;
			}
			addr->to_bytes = ext_addr_to_bytes;
			data_frame->address = addr;
		} else {
			address_fields_short_t *addr =
				malloc(sizeof(address_fields_short_t));
			if (!addr) {
				free(data_frame);
				break;
			}
			addr->to_bytes = short_addr_to_bytes;
			data_frame->address = addr;
		}

		data_frame->payload = malloc(payload_len);
		if (!data_frame->payload) {
			free(data_frame->address);
			free(data_frame);
		}

		data_frame->to_bytes = data_frame_to_bytes;
		data_frame->_payload_len = payload_len;
		data_frame->dtor = data_frame_dtor;
		data_frame->security = NULL;
		FRAME_FCF_SET(*((uint16_t *)data_frame->frame_control),
			      FRAME_FCF_TYPE, FRAME_TYPE_DATA);
		frame = data_frame;
		break;
	default:
		printf("%ld frame type is not supported\n", frame_type);
	}

	va_end(args);
	return frame;
}

void frame_destroy(void **pframe)
{
	frame_any_t *frame = *pframe;
	frame->dtor(pframe);
}

int frame_to_bytes(void *frame, uint8_t *buf)
{
	frame_any_t *fframe = frame;
	if (!frame) {
		return -EINVAL;
	}

	return fframe->to_bytes(frame, buf);
}
```

## src/ieee802154_types.h
```c
#ifndef _IEEE802154_TYPES_H
#define _IEEE802154_TYPES_H

#include <stdint.h>

#define FRAME_TYPE_DATA (0x1)
#define FRAME_TYPE_ACK 0x02
#define FRAME_TYPE_BEACON 0x00
#define FRAME_TYPE_COMMAND 0x03
#define FRAME_TYPE_DATA 0x01
#define FRAME_TYPE_EXTENDED 0x07
#define FRAME_TYPE_FRAGMENT 0x06
#define FRAME_TYPE_MULTIPURPOSE 0x05

#define FRAME_FCF_TYPE (0)
#define FRAME_FCF_SEC_EN (3)
#define FRAME_FCF_FPB (4)
#define FRAME_FCF_AR (5)
#define FRAME_FCF_PAN_ID_COMP (6)
#define FRAME_FCF_DEST_ADDR_MODE (10)
#define FRAME_FCF_VER (12)
#define FRAME_FCF_SRC_ADDR_MODE (14)

#define FRAME_FCF_TYPE_MASK ((1UL << 0) | (1UL << 1) | (1UL << 2))
#define FRAME_FCF_SEC_EN_MASK (1UL << 3)
#define FRAME_FCF_FPB_MASK (1UL << 4)
#define FRAME_FCF_AR_MASK (1UL << 5)
#define FRAME_FCF_PAN_ID_COMP_MASK (1UL << 6)
#define FRAME_FCF_DEST_ADDR_MODE_MASK ((1UL << 10) | (1UL << 11))
#define FRAME_FCF_VER_MASK ((1UL << 12) | (1UL << 13))
#define FRAME_FCF_SRC_ADDR_MODE_MASK ((1UL << 14) | (1UL << 15))

#define FRAME_FCF_SET(fcf, BIT_NAME, value)                                    \
	do {                                                                   \
		uint16_t backup = fcf | (BIT_NAME##_MASK);                     \
		fcf &= ~(BIT_NAME##_MASK);                                     \
		fcf |= (value << BIT_NAME);                                    \
		fcf &= backup;                                                 \
	} while (0);

#define FRAME_FCF_GET(fcf, BIT_NAME) (fcf & BIT_NAME##_MASK) >> BIT_NAME

typedef int (*to_bytes_t)(void *self, uint8_t *);
typedef void (*dtor_t)(void **self);

typedef struct __attribute__((packed)) {
	to_bytes_t to_bytes;
	uint8_t dest_pan_ID[2];
	uint8_t dest_addr[8];
	uint8_t src_pan_ID[2];
	uint8_t src_addr[8];
} address_fields_ext_t;

typedef struct __attribute__((packed)) {
	to_bytes_t to_bytes;
	uint8_t dest_pan_ID[2];
	uint8_t dest_addr[2];
	uint8_t src_pan_ID[2];
	uint8_t src_addr[2];
} address_fields_short_t;

typedef struct __attribute__((packed)) {
	dtor_t dtor;
	to_bytes_t to_bytes;

	uint8_t frame_control[2];
	uint8_t seq_number;
	void *address;
	void *security;
	uint8_t *payload;
	uint8_t _payload_len; /* Don't touch it */
	uint8_t fcs[2];
} data_frame_t;

typedef struct __attribute__((packed)) {
	dtor_t dtor;
	to_bytes_t to_bytes;
} frame_any_t;

/**
 * Creates the frame of frame_type
 * 
 * Arguments for frame types:
 * FRAME_TYPE_DATA:
 * 					-	(arg1) use_extended_addr (bool)
 * 					-	(arg2) payload_len		 (uint8_t)
 * 					-	(arg3) security_type	 (uint8_t) [not supported]
 */
void *frame_create(unsigned long frame_type, ...);
void frame_destroy(void **pframe);
int frame_to_bytes(void *frame, uint8_t *buf);

#endif /* _IEEE802154_TYPES_H */
```
