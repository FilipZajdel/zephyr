## CMakeLists.txt
```
# SPDX-License-Identifier: Apache-2.0

cmake_minimum_required(VERSION 3.13.1)
find_package(Zephyr REQUIRED HINTS $ENV{ZEPHYR_BASE})
project(wpancmd)

target_include_directories(app PRIVATE ${ZEPHYR_BASE}/subsys/net/l2)
target_include_directories(app PRIVATE ${ZEPHYR_BASE}/subsys/net/ip)
target_include_directories(app PRIVATE ${ZEPHYR_BASE}/subsys/usb)

FILE(GLOB app_sources src/*.c)
target_sources(app PRIVATE ${app_sources})
```

## sample.yaml
```
sample:
  description: Test native posix 802.15.4 radio_api driver
  name: native_posix802154_test
common:
  tags: net ieee802154
  harness: net
tests:
  sample.net.wpanusb:
    depends_on: ieee802154
  sample.net.wpanusb_frdm_cr20a:
    extra_args: SHIELD=frdm_cr20a
    platform_whitelist: frdm_k64f
```

## prj.conf
```kconfig
CONFIG_NETWORKING=y
CONFIG_NET_PKT_TX_COUNT=4
CONFIG_NET_BUF_DATA_SIZE=128

CONFIG_IEEE802154=y
CONFIG_IEEE802154_RAW_MODE=y

CONFIG_SHELL=n
CONFIG_KERNEL_SHELL=n

CONFIG_NET_CONFIG_SETTINGS=y
CONFIG_NET_CONFIG_AUTO_INIT=n
CONFIG_NET_LOG=y
CONFIG_BUILD_OUTPUT_HEX=y
CONFIG_BUILD_OUTPUT_EXE=y

CONFIG_USE_BABBLESIM=y
```

## src/main.c
```c
/*
 * Copyright (c) 2016-2019 Intel Corporation
 *
 * SPDX-License-Identifier: Apache-2.0
 */
#define LOG_LEVEL 4
#include <logging/log.h>
LOG_MODULE_REGISTER(wpancmd);

#include <stdio.h>
#include <zephyr.h>
#include <net/buf.h>
#include <stdlib.h>
#include <net/ieee802154_radio.h>
#include <ieee802154/ieee802154_frame.h>
#include <net_private.h>
#include "config_parser.h"
#include "posix_board_if.h"

#define CFG_COLS_OFFSET 4
#define TEST_CONFIG_FILENAME "../../../test_data"

typedef struct ieee802154_test_config {
	uint8_t ieee_addr[8];
	uint8_t short_addr[2];
	uint8_t pan_id[2];
	bool is_pan_coord;
} ieee802154_test_config_t;

typedef struct ieee802154_test {
	ieee802154_test_config_t *configs;
	int ctr;
	int ntests;
} ieee802154_test_t;

static struct ieee802154_radio_api *radio_api;
static struct device *ieee802154_dev;
static ieee802154_test_t test_data = { .ctr = 0, .ntests = 0, .configs = NULL };

static void radio_configure(ieee802154_test_config_t *config);

static int load_test_data(const char *config_file, ieee802154_test_t *test_data)
{
	int configs_ctr;
	int tests_num;
	struct config_parser tests_parser = {
		.ncols = 10,
		.datatypes = { CSV_DATATYPE_BYTESTREAM, CSV_DATATYPE_BYTESTREAM,
			       CSV_DATATYPE_BYTESTREAM, CSV_DATATYPE_BOOLEAN,
			       CSV_DATATYPE_BYTESTREAM, CSV_DATATYPE_BYTESTREAM,
			       CSV_DATATYPE_BYTESTREAM, CSV_DATATYPE_BOOLEAN,
			       CSV_DATATYPE_BYTESTREAM,
			       CSV_DATATYPE_BYTESTREAM }
	};

	if (!config_openfile(config_file)) {
		return -EIO;
	}

	tests_num = get_config_lines_number();

	test_data->configs =
		malloc(sizeof(ieee802154_test_config_t) * tests_num);
	if (!test_data->configs) {
		config_closefile();
		return -ENOMEM;
	}

	test_data->ctr = 0;

	configs_ctr = 0;
	for (;; configs_ctr++) {
		if (!config_parse_line(&tests_parser)) {
			config_parser_clean(&tests_parser);
			break;
		}

		memcpy(test_data->configs[configs_ctr].ieee_addr,
		       tests_parser.dest[CFG_COLS_OFFSET + 0].bytestream + 1,
		       8);
		memcpy(test_data->configs[configs_ctr].short_addr,
		       tests_parser.dest[CFG_COLS_OFFSET + 1].bytestream + 1,
		       2);
		memcpy(test_data->configs[configs_ctr].pan_id,
		       tests_parser.dest[CFG_COLS_OFFSET + 2].bytestream + 1,
		       2);

		test_data->configs[configs_ctr].is_pan_coord =
			*tests_parser.dest[3].boolean;

		config_parser_clean(&tests_parser);
	}

	test_data->ntests = configs_ctr;
	config_closefile();

	return configs_ctr;
}

static void example_cleanup()
{
        if (test_data.configs) {
                free(test_data.configs);
        }
}

int net_recv_data(struct net_if *iface, struct net_pkt *pkt)
{
	size_t len = net_pkt_get_len(pkt);
	uint8_t rx_buf[127];
	uint8_t *p = rx_buf;
	int ret;

	LOG_INF("Got data, pkt %p, len %d", pkt, len);

	net_pkt_hexdump(pkt, "<");

	if (len > (127 - 2)) {
		LOG_ERR("Too large packet");
		ret = -ENOMEM;
		goto out;
	}

	/**
	 * Add length 1 byte
	 */
	*p++ = (uint8_t)len;

	/* This is needed to work with pkt */
	net_pkt_cursor_init(pkt);

	ret = net_pkt_read(pkt, p, len);
	if (ret < 0) {
		LOG_ERR("Cannot read pkt");
		goto out;
	}

	p += len;

	/**
	 * Add LQI at the end of the packet
	 */
	*p = net_pkt_ieee802154_lqi(pkt);

out:
	net_pkt_unref(pkt);
	radio_configure(&test_data.configs[test_data.ctr++]);

	return ret;
}

/** Configure addresses of this device */
static void device_addr_set(const uint8_t *addr, bool extended, bool pan)
{
	struct ieee802154_filter filter;

	if (pan) {
		filter.pan_id = *(uint16_t *)addr;
		radio_api->filter(ieee802154_dev, true,
				  IEEE802154_FILTER_TYPE_PAN_ID, &filter);
	} else if (extended) {
		filter.ieee_addr = (uint8_t *)addr;
		radio_api->filter(ieee802154_dev, true,
				  IEEE802154_FILTER_TYPE_IEEE_ADDR, &filter);
	} else {
		filter.short_addr = *(uint16_t *)addr;
		radio_api->filter(ieee802154_dev, true,
				  IEEE802154_FILTER_TYPE_SHORT_ADDR, &filter);
	}
}

/** Set coordinator role of the device */
static void set_coord_role(bool enabled)
{
	const struct ieee802154_config config = { .pan_coordinator = enabled };

	radio_api->configure(ieee802154_dev, IEEE802154_CONFIG_PAN_COORDINATOR,
			     &config);
}

static void radio_configure(ieee802154_test_config_t *config)
{
	set_coord_role(config->is_pan_coord);
	device_addr_set(config->ieee_addr, true, false);
	device_addr_set(config->pan_id, false, true);
	device_addr_set(config->short_addr, false, false);
}

static void example_init(void)
{
	enum ieee802154_config_type config_types[] = {
		IEEE802154_CONFIG_AUTO_ACK_FPB, IEEE802154_CONFIG_PROMISCUOUS
	};
	const struct ieee802154_config configs[] = {
		{ .auto_ack_fpb.enabled = true,
		  .auto_ack_fpb.mode = IEEE802154_FPB_ADDR_MATCH_ZIGBEE },
		{ .promiscuous = true }
	};

	uint8_t channel = 20;
	int8_t power = -12;

	net_pkt_init();
	ieee802154_dev =
		device_get_binding(CONFIG_IEEE802154_NATIVE_POSIX_DRV_NAME);

	if (ieee802154_dev) {
		radio_api = (struct ieee802154_radio_api *)
				    ieee802154_dev->api;
	} else {
		printk("Couldn't bind %s\n",
		       CONFIG_IEEE802154_NATIVE_POSIX_DRV_NAME);
		posix_exit(-EFAULT);
	}

	printf("%10s\n", "Radio configuration:");
	printf("%-10s %u\n", "Channel:", channel);
	printf("%-10s %d dBm\n", "Power:", power);
	printf("Configuration can be changed either via "
	       "menuconfig or prj.conf\n\n");

	radio_api->set_channel(ieee802154_dev, channel);
	radio_api->set_txpower(ieee802154_dev, power);

	for (int i = 0; i < ARRAY_SIZE(config_types); i++) {
		radio_api->configure(ieee802154_dev, config_types[i],
				     &configs[i]);
	}

	radio_configure(&test_data.configs[test_data.ctr++]);
	int status = radio_api->start(ieee802154_dev);

	if (status) {
		printf("Radio couldn't be started - "
		       "make sure that program was started in babble sim mode (-bsim)");
		posix_exit(-EFAULT);
	}
}

void main(void)
{
	/* Read the test config file */
	load_test_data(TEST_CONFIG_FILENAME, &test_data);

	/* Do the device binding, start the radio and initialize net_pkt */
	example_init();

	k_sleep(K_FOREVER);

        example_cleanup();

	/* Terminate */
	posix_exit(0);
}
```

## src/config_parser.c
```c
#include <stdio.h>
#include <stdint.h>
#include <stdbool.h>
#include <string.h>
#include <stdlib.h>
#include <errno.h>

#include "config_parser.h"

typedef int (*config_parser_func)(char *, void **);

struct config_line {
	int ncols;
	char line[MAX_LINE_LEN];
	char *cols[MAX_COLS_IN_FILE];
	int col_lens[MAX_COLS_IN_FILE];
};

static int parse_string(char *s, void **pvstring);
static int parse_boolean(char *s, void **pvboolean);
static int parse_bytestream(char *s, void **bytes);

static FILE *fd = NULL;
static config_parser_func config_parsers[] = { parse_bytestream, parse_string,
					 parse_boolean };
static int config_lines_number;

static int count_config_lines_in_file(void)
{
	int nlines;
	char line[MAX_LINE_LEN];

	for (nlines = 0; fgets(line, sizeof(line), fd); ){
		if (line[0] != IGNORE_LINE_CHAR) {
			nlines++;
		}
	}

	return nlines;
}

int get_config_lines_number(void)
{
	return config_lines_number;
}

bool config_openfile(const char *filename)
{
	bool ret;

	fd = fopen(filename, "r");
	ret = (bool)fd;

	if (ret) {
		config_lines_number = count_config_lines_in_file();
		fseek(fd, 0, SEEK_SET);
	} else {
		config_lines_number = -1;
	}

	return ret;
}

void config_closefile()
{
	fclose(fd);
}

static void strreplace(char *str, char old, char new)
{
	for (int i = 0; i < strlen(str); i++) {
		if (str[i] == old) {
			str[i] = new;
		}
	}
}

static bool config_getline(struct config_line *config_line)
{
	if (!fd) {
		printf("File is not open\n");
		return false;
	}

	do {
		if (!fgets(config_line->line, sizeof(config_line->line), fd)) {
			return false;
		}
	} while (config_line->line[0] == IGNORE_LINE_CHAR);

	/* Trim the string */
	strreplace(config_line->line, '\n', 0);
	config_line->ncols = 0;

	char *prev_col = config_line->line;

	for (int i = 0; i <= strlen(config_line->line); i++) {
		if (config_line->line[i] == SEPARATOR_CHAR ||
		    i == strlen(config_line->line)) {
			char *curr_col = config_line->line + i + 1;
			config_line->cols[config_line->ncols] = prev_col;
			config_line->col_lens[config_line->ncols] =
				(curr_col - 1) - prev_col;
			config_line->ncols++;
			prev_col = curr_col;
		}
	}

	return true;
}

/** Parses NULL-terminated string of bytes in hex format to bytes 
 * 
 * Arguments:
 * s             -   Null-terminated string containing bytestream in hex notation
 * pvbytes [out] -   Buffer that will be written, bytes[0] contains the bytestream len.
 *                 The buffer is allocated inside function and needs to be freed after.
 * 
 * Returns:
 * Number of bytes parsed   -   On success
 * Negative                 -   On failure
*/
static int parse_bytestream(char *s, void **pvbytes)
{
	int nchars;
	int nbytes;
	uint8_t **bytes = (uint8_t **)pvbytes;

	*bytes = malloc((strlen(s) / 2) + 1);
	if (!(*bytes)) {
		return -ENOMEM;
	}

	uint8_t *bytes_out = (*bytes) + 1;
	uint8_t *bytes_len = (*bytes);

	for (nbytes = 0, nchars = 0; /*s[nchars]*/nchars < strlen(s); nchars += 2, nbytes++) {
		char number[] = { s[nchars], s[nchars + 1], 0 };
		bytes_out[nbytes] = strtol(number, NULL, 16);
	}

	*bytes_len = nbytes;
	return nbytes;
}

/** Parses NULL-terminated string of boolean value to bool
 * 
 * Arguments:
 * s             -   Null-terminated string containing "false", "true", "1", "0"
 *                   Case sensitive.
 * pvboolean [out] -   Buffer that will be written with parsed value
 *                 The buffer is allocated inside function and needs to be freed after.
 * 
 * Returns:
 * 0          -   On success
 * Negative   -   On failure
*/
static int parse_boolean(char *s, void **pvboolean)
{
	int ret = -EINVAL;
	bool **boolean = (bool **)pvboolean;
	*boolean = malloc(sizeof(bool));

	if (strcmp(s, "true") == 0) {
		**boolean = true;
		ret = 0;
	} else if (strcmp(s, "false") == 0) {
		**boolean = false;
		ret = 0;
	} else if (strcmp(s, "1") == 0) {
		**boolean = true;
		ret = 0;
	} else if (strcmp(s, "0") == 0) {
		**boolean = false;
		ret = 0;
	}

	return ret;
}

/** Parses NULL-terminated string of characters to string
 * 
 * Arguments:
 * s             -   Null-terminated string containing "false", "true", "1", "0"
 *                   Case sensitive.
 * pvstring [out] -   Buffer that will be written with parsed value
 *                 The buffer is allocated inside function and needs to be freed after.
 * 
 * Returns:
 * String len          -   On success
 * Negative            -   On failure
*/
static int parse_string(char *s, void **pvstring)
{
	int len = strlen(s);
	char **str = (char **)pvstring;

	*str = malloc(len + 1);
	memcpy(*str, s, len);
	(*str)[len] = 0;
	return len;
}

/** 
 * Parse next line found in open file.
 * 
 * Arguments:
 * parser	-	Points to parser used to parse the line
 * 
 * Returns:
 * false	-	Failed to parse next line (EOL or line format doesn't match 
 * 											parser)
 * true		-	Successfully parsed the line
 */
bool config_parse_line(struct config_parser *parser)
{
	struct config_line line;

	if (!config_getline(&line)) {
		return false;
	}

	if (parser->ncols != line.ncols) {
		return false;
	}

	for (int col = 0; col < parser->ncols; col++) {
		char column[MAX_COLUMN_LEN] = "";
		int ret;

		memcpy(column, line.cols[col], line.col_lens[col]);
		column[line.col_lens[col]] = 0;
		config_parser_func config_parser_f =
			config_parsers[parser->datatypes[col]];
		ret = config_parser_f(column, &parser->dest[col].any);
		if (ret < 0) {
			return false;
		}
	}

	return true;
}

/**
 * Clean the data allocated during parsing the line
 * 
 * Arguments:
 * parser	-	Points to parser that will be cleaned up
 */
void config_parser_clean(struct config_parser *parser)
{
	for (int col=0; col<parser->ncols; col++) {
		free(parser->dest[col].any);
		parser->dest[col].any = NULL;
	}
}
```

## src/ieee802154_types.h
```c
#ifndef _IEEE802154_TYPES_H
#define _IEEE802154_TYPES_H

#include <stdint.h>

#define FRAME_TYPE_DATA (0x1)
#define FRAME_TYPE_ACK 0x02
#define FRAME_TYPE_BEACON 0x00
#define FRAME_TYPE_COMMAND 0x03
#define FRAME_TYPE_DATA 0x01
#define FRAME_TYPE_EXTENDED 0x07
#define FRAME_TYPE_FRAGMENT 0x06
#define FRAME_TYPE_MULTIPURPOSE 0x05

#define FRAME_FCF_TYPE (0)
#define FRAME_FCF_SEC_EN (3)
#define FRAME_FCF_FPB (4)
#define FRAME_FCF_AR (5)
#define FRAME_FCF_PAN_ID_COMP (6)
#define FRAME_FCF_DEST_ADDR_MODE (10)
#define FRAME_FCF_VER (12)
#define FRAME_FCF_SRC_ADDR_MODE (14)

#define FRAME_FCF_TYPE_MASK ((1UL << 0) | (1UL << 1) | (1UL << 2))
#define FRAME_FCF_SEC_EN_MASK (1UL << 3)
#define FRAME_FCF_FPB_MASK (1UL << 4)
#define FRAME_FCF_AR_MASK (1UL << 5)
#define FRAME_FCF_PAN_ID_COMP_MASK (1UL << 6)
#define FRAME_FCF_DEST_ADDR_MODE_MASK ((1UL << 10) | (1UL << 11))
#define FRAME_FCF_VER_MASK ((1UL << 12) | (1UL << 13))
#define FRAME_FCF_SRC_ADDR_MODE_MASK ((1UL << 14) | (1UL << 15))


#define FRAME_FCF_SET(fcf, BIT_NAME, value)                                    \
	do {                                                                   \
		uint16_t backup = fcf | (BIT_NAME##_MASK);                    \
		fcf &= ~(BIT_NAME##_MASK);                                    \
		fcf |= (value << BIT_NAME);                                   \
		fcf &= backup;                                                \
	} while (0);

#define FRAME_FCF_GET(fcf, BIT_NAME) (fcf & BIT_NAME##_MASK) >> BIT_NAME

typedef int (*to_bytes_t)(void *self, uint8_t *);
typedef void (*dtor_t)(void **self);

typedef struct __attribute__((packed)) {
	to_bytes_t to_bytes;
	uint8_t dest_pan_ID[2];
	uint8_t dest_addr[8];
	uint8_t src_pan_ID[2];
	uint8_t src_addr[8];
} address_fields_ext_t;

typedef struct __attribute__((packed)) {
	to_bytes_t to_bytes;
	uint8_t dest_pan_ID[2];
	uint8_t dest_addr[2];
	uint8_t src_pan_ID[2];
	uint8_t src_addr[2];
} address_fields_short_t;

typedef struct __attribute__((packed)) {
	dtor_t dtor;
	to_bytes_t to_bytes;

	uint8_t frame_control[2];
	uint8_t seq_number;
	void *address;
	void *security;
	uint8_t *payload;
	uint8_t _payload_len; /* Don't touch it */
	uint8_t fcs[2];
} data_frame_t;

typedef struct __attribute__((packed)) {
	dtor_t dtor;
	to_bytes_t to_bytes;
} frame_any_t;

/**
 * Creates the frame of frame_type
 * 
 * Arguments for frame types:
 * FRAME_TYPE_DATA:
 * 					-	(arg1) use_extended_addr (bool)
 * 					-	(arg2) payload_len		 (uint8_t)
 * 					-	(arg3) security_type	 (uint8_t) [not supported]
 */
void *frame_create(unsigned long frame_type, ...);
void frame_destroy(void **pframe);
int frame_to_bytes(void *frame, uint8_t *buf);

#endif /* _IEEE802154_TYPES_H */
```
